## main/Kconfig.projbuild
```kconfig
menu "Official Chat"

config USE_AUDIO_PROCESSOR
    bool "Enable official_chat audio processor"
    default y
    depends on IDF_TARGET_ESP32S3 && SPIRAM
    help
        Enable the AFE-based audio processor inside official_chat.

config USE_DEVICE_AEC
    bool "Enable official_chat device-side AEC"
    default n
    depends on USE_AUDIO_PROCESSOR
    help
        Enable device-side AEC for the AFE audio processor.

config SEND_WAKE_WORD_DATA
    bool "Send wake word audio before listen/start"
    default y
    depends on IDF_TARGET_ESP32S3 && SPIRAM
    help
        Encode and send the cached wake word audio before a wake-word-triggered chat.

config WAKE_WORD_DETECTION_IN_LISTENING
    bool "Enable wake word detection while listening"
    default n
    depends on IDF_TARGET_ESP32S3 && SPIRAM
    help
        Keep wake word detection active during listening so wake words can
        interrupt an ongoing conversation.

config OFFICIAL_CHAT_OTA_URL
    string "Official chat OTA URL"
    default "https://api.tenclass.net/xiaozhi/ota/"
    help
        Default OTA endpoint used by official_chat when wifi.ota_url is not
        present in NVS.

config OFFICIAL_CHAT_LANGUAGE_CODE
    string "Official chat language code"
    default "zh-CN"
    help
        Language code used by official_chat for OTA requests and metadata.

config OFFICIAL_CHAT_UDP_AUDIO_STALL_TIMEOUT_MS
    int "Official chat UDP audio stall timeout (ms)"
    default 5000
    range 1000 15000
    help
        Maximum silence gap allowed between downlink UDP audio packets while
        MQTT TTS text is still arriving. Increase this when Wi-Fi jitter causes
        false mid-sentence stalls.

endmenu

menu "Standalone HTTPS OTA"

choice OTA_SERVICE_SOURCE
    prompt "OTA source"
    default OTA_SOURCE_ONENET
    help
        Select the protocol provider used by the unified OTA service. The UI
        and the three-step service flow are identical for both sources.

config OTA_SOURCE_ONENET
    bool "OneNET"

config OTA_SOURCE_REMOTE_MANIFEST
    bool "Self-hosted HTTPS manifest"

endchoice

config OTA_SERVICE_REMOTE_MANIFEST_URL
    string "Remote OTA manifest URL"
    depends on OTA_SOURCE_REMOTE_MANIFEST
    default "https://watch.example.com/v1/watch/ota/manifest?channel=stable"
    help
        HTTPS manifest endpoint published by the remote OTA server.

config OTA_SERVICE_REMOTE_ALLOWED_HOST
    string "Remote OTA allowed host"
    depends on OTA_SOURCE_REMOTE_MANIFEST
    default "watch.example.com"
    help
        Exact host portion accepted in both the manifest URL and image URL.

config OTA_SERVICE_TEST_FAULT_MODE
    int "OTA test fault mode"
    default 0
    range 0 3
    help
        Development-only OTA fault injection: 0 none, 1 abort at 20%,
        2 abort at 50%, 3 abort at 90%. Keep 0 in product images.

config OTA_SERVICE_TEST_RESTART_HOLD_MS
    int "OTA finish-to-restart hold (ms)"
    default 0
    range 0 120000
    help
        Hold after esp_https_ota_finish() and before esp_restart() for
        controlled reset/power-loss testing. Keep 0 in product images.

config OTA_BOOT_CHECK_TEST_HOLD_MS
    int "OTA pending verify hold (ms)"
    default 0
    range 0 120000
    help
        Hold after local PENDING_VERIFY checks and before marking valid, so a
        dedicated test image can be reset in that window. Keep 0 in products.

config OTA_BOOT_CHECK_TEST_FORCE_FAIL
    bool "Force OTA pending verify local check failure"
    default n
    help
        Force the local PENDING_VERIFY boot check to fail and exercise IDF
        rollback. Keep disabled in product images.

config OTA_SERVICE_BOARD_TEST
    bool "Run standalone OTA board test"
    default n
    help
        Start one explicit standalone OTA test after Wi-Fi service readiness.
        It is for a dedicated test image only; normal boot never fetches a
        manifest or writes an OTA slot.

config OTA_SERVICE_BOARD_TEST_START_DELAY_MS
    int "OTA board test start delay (ms)"
    depends on OTA_SERVICE_BOARD_TEST
    default 30000
    range 1000 120000
    help
        Delay after boot before the test waits for Wi-Fi and TLS time. This
        also lets boot-time HTTPS probes finish before the one-shot test.

config OTA_DELTA_ENABLED
    bool "Enable delta OTA (standalone manifest delta fields)"
    default n
    help
        Apply delta patches from the standalone manifest when its optional
        delta fields are present and complete. Keep disabled in product images
        unless the server publishes verified patches; fallback to full image
        on any delta failure.

config OTA_DELTA_MAX_RETRY
    int "Delta OTA max retry count (fallback after)"
    depends on OTA_DELTA_ENABLED
    default 3
    range 0 5
    help
        Number of retries for a failed delta apply before falling back to the
        full-image path. 0 disables retries and falls back immediately.

config OTA_DELTA_FEED_BUFFER_BYTES
    int "Delta OTA patch feed buffer size (bytes)"
    depends on OTA_DELTA_ENABLED
    default 8192
    range 1024 16384
    help
        Per-chunk buffer used to stream the downloaded patch into the
        esp_delta_ota engine. Allocated from PSRAM when available.

config OTA_METRICS_ENABLED
    bool "Enable OTA metrics"
    default n
    help
        Persist OTA stage results only in dedicated diagnostics builds.

config OTA_METRICS_LOG_COUNT
    int "OTA metrics recent-result log count"
    depends on OTA_METRICS_ENABLED
    default 10
    range 1 50
    help
        Number of recent OTA upgrade results persisted to NVS in a ring
        buffer by ota_metrics.

endmenu

menu "AI Memory Watch"

config MEMORY_WATCH_DEFAULT_ENDPOINT_ENABLED
    bool "Enable default watch endpoint config"
    default y
    help
        Provide a compile-time fallback endpoint for AI Memory Watch when NVS
        does not contain a SoftAP-provisioned endpoint yet. NVS remains the
        higher-priority runtime configuration source.

config MEMORY_WATCH_DEFAULT_BASE_URL
    string "Default watch endpoint base URL"
    depends on MEMORY_WATCH_DEFAULT_ENDPOINT_ENABLED
    default "https://watch.example.com"
    help
        Public watch endpoint base URL. The ESP32 only calls /v1/watch/*
        under this endpoint; Hermes API Server and Dashboard must remain
        server-side private services.

config MEMORY_WATCH_DEFAULT_DEVICE_ID
    string "Default watch device ID"
    depends on MEMORY_WATCH_DEFAULT_ENDPOINT_ENABLED
    default "watch-001"
    help
        Device ID used by the watch endpoint to select the matching
        device_token on the server.

config MEMORY_WATCH_DEFAULT_DEVICE_TOKEN
    string "Default watch device token"
    depends on MEMORY_WATCH_DEFAULT_ENDPOINT_ENABLED
    default ""
    help
        Device token sent as Authorization: Bearer <device_token> to the watch
        endpoint. This is only a watch device token; never put Hermes, MiMo,
        Cloudflare, or API Server keys here. Leave empty for production images
        that must be configured through SoftAP/NVS.

config MEMORY_WATCH_DEFAULT_TIMEOUT_MS
    int "Default watch request timeout (ms)"
    depends on MEMORY_WATCH_DEFAULT_ENDPOINT_ENABLED
    default 120000
    range 1000 300000
    help
        Maximum watch-side wait time for one voice/text request. Keep this
        slightly above the server-side request budget so the server can return
        a fixed V1 JSON timeout before the ESP32 gives up.

config MEMORY_WATCH_DEFAULT_ALLOW_HTTP
    bool "Allow default HTTP watch endpoint"
    depends on MEMORY_WATCH_DEFAULT_ENDPOINT_ENABLED
    default n
    help
        Allow an http:// default endpoint. Keep disabled for the public V1
        domain; enable only for local LAN development endpoints.

config MEMORY_WATCH_BOOT_HEALTH_CHECK
    bool "Run boot health check"
    default y
    depends on MEMORY_WATCH_DEFAULT_ENDPOINT_ENABLED
    help
        After networking is ready, check /v1/watch/health once so the Hermes
        page can show the initial online status during development.

config MEMORY_WATCH_BOOT_TEXT_SMOKE
    bool "Run boot text smoke"
    default n
    depends on MEMORY_WATCH_BOOT_HEALTH_CHECK
    help
        Send one development text command after a successful boot health check.
        Keep disabled for V1 because it writes extra memory entries to Hermes.

config MEMORY_WATCH_BOOT_TEXT
    string "Boot text smoke content"
    depends on MEMORY_WATCH_BOOT_TEXT_SMOKE
    default "记一下 ESP32 文本链路实机测试"
    help
        Text used only when MEMORY_WATCH_BOOT_TEXT_SMOKE is enabled.

config MEMORY_WATCH_WEBSOCKET_ENABLED
    bool "Use WebSocket for Hermes voice conversation"
    default y
    depends on MEMORY_WATCH_DEFAULT_ENDPOINT_ENABLED
    help
        Enable the V2.1 experimental /v1/watch/ws path for active Hermes
        conversations. The existing HTTP voice-command path remains available
        as a rollback route during development.

config MUSIC_SERVICE_BOARD_TEST
    bool "Run online music fixed-stream board test"
    default n
    help
        Start one fixed-stream playback test after network service readiness.
        This is for a dedicated test image only; normal firmware never starts
        music automatically.

config MUSIC_SERVICE_BOARD_TEST_START_DELAY_MS
    int "Music board test start delay (ms)"
    depends on MUSIC_SERVICE_BOARD_TEST
    default 20000
    range 1000 120000
    help
        Delay before the fixed-stream playback test starts, allowing boot-time
        HTTPS probes and the UI/network owners to settle.

config RUNTIME_RESOURCE_GATE_BOARD_TEST
    bool "Run runtime coordinator board state-machine test"
    default n
    help
        Run a one-shot board-side sequence with simulated participants to
        exercise request coverage, stale ACK, rejection, timeout, grant
        failure, and rollback fail-closed behavior.
        Keep disabled for normal images.

config RUNTIME_RESOURCE_GATE_BOARD_TEST_START_DELAY_MS
    int "Runtime coordinator board test start delay (ms)"
    depends on RUNTIME_RESOURCE_GATE_BOARD_TEST
    default 12000
    range 1000 120000
    help
        Delay before the one-shot test starts. This gives UI, networking and
        Memory Watch workers time to initialize before the test creates
        resource pressure.

endmenu
```

## sdkconfig.defaults
```kconfig
CONFIG_BT_ENABLED=y
CONFIG_BT_BLUEDROID_ENABLED=n
CONFIG_BT_NIMBLE_ENABLED=y
CONFIG_BT_NIMBLE_ROLE_CENTRAL=n
CONFIG_BT_NIMBLE_ROLE_OBSERVER=n
CONFIG_BT_NIMBLE_GATT_CLIENT=n
CONFIG_BT_NIMBLE_50_FEATURE_SUPPORT=n
CONFIG_BT_NIMBLE_EXT_SCAN=n
CONFIG_BT_NIMBLE_MAX_CONNECTIONS=1
CONFIG_BT_CTRL_BLE_MAX_ACT=2
CONFIG_BT_CTRL_BLE_SCAN=y
CONFIG_BT_CTRL_BLE_MASTER=y
CONFIG_BOOTLOADER_APP_ROLLBACK_ENABLE=y
CONFIG_IDF_EXPERIMENTAL_FEATURES=y
CONFIG_BOOTLOADER_CACHE_32BIT_ADDR_QUAD_FLASH=y
CONFIG_ESP_INT_WDT_TIMEOUT_MS=1000
CONFIG_LV_USE_PERF_MONITOR_LOG_MODE=n
CONFIG_LV_USE_FS_POSIX=y
CONFIG_LV_FS_POSIX_LETTER=65
CONFIG_LV_FS_POSIX_PATH="/resources"
CONFIG_LV_FS_POSIX_CACHE_SIZE=0
CONFIG_LV_USE_FONT_COMPRESSED=y
CONFIG_NETWORK_PROV_SCAN_MAX_ENTRIES=8
CONFIG_LV_USE_LODEPNG=y
CONFIG_APP_PROJECT_VER_FROM_CONFIG=y
CONFIG_APP_PROJECT_VER="1.0.6"
```
